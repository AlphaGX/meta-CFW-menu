## conf/layer.conf
```bitbake
# We have a conf and classes directory, add to BBPATH
BBPATH .= ":${LAYERDIR}"

# We have recipes-* directories, add to BBFILES
BBFILES += "${LAYERDIR}/recipes-*/*/*.bb \
            ${LAYERDIR}/recipes-*/*/*.bbappend"

BBFILE_COLLECTIONS += "meta-CFW-menu"
BBFILE_PATTERN_meta-CFW-menu = "^${LAYERDIR}/"
BBFILE_PRIORITY_meta-CFW-menu = "6"

LAYERDEPENDS_meta-CFW-menu = "core"
LAYERSERIES_COMPAT_meta-CFW-menu = "scarthgap"
```
